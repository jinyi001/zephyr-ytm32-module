## dts/bindings/ytmicro,ytm32-cgu.yaml
```yaml
description: YTMicro YTM32 Clock Generation Unit (CGU)

compatible: "ytmicro,ytm32-cgu"

include: [clock-controller.yaml, base.yaml]

properties:
  "#clock-cells":
    const: 1

  firc-frequency:
    type: int
    required: false
    description: |
      Fast Internal RC Oscillator frequency in Hz.
      This is a hardware-fixed value set in the SoC DTSI — do not override
      in board DTS.  The driver uses BUILD_ASSERT to cross-check this against
      the YTM32_FIRC_HZ constant in the SoC clock header.
        YTM32B1MD1: 96 000 000 (RM §12.1 / FEATURE_SCU_FIRC_FREQ)
        YTM32B1MC0: 80 000 000

  sirc-frequency:
    type: int
    required: false
    description: |
      Slow Internal RC Oscillator frequency in Hz.
      Hardware-fixed; set in the SoC DTSI, do not override in board DTS.
        YTM32B1MD1 / MC0: 12 000 000 (RM §12.1 / FEATURE_SCU_SIRC_FREQ)

  system-clock-source:
    type: int
    required: false
    default: 0
    description: |
      System clock source selector.  Use YTM32_SYSTEM_CLOCK_SRC_* values.
        0 = FIRC   (default after reset)
        1 = FXOSC  (requires fxosc-frequency in board DTS)
        2 = PLL    (requires the pll-* properties below)

  fxosc-frequency:
    type: int
    required: false
    description: |
      External fast oscillator (crystal) frequency in Hz.
      Required when system-clock-source is FXOSC or PLL sourced from FXOSC.
      Valid range per RM §12.1: 4 000 000 – 40 000 000 Hz.
      The driver enforces this range with BUILD_ASSERT at compile time.
      Set this in the board DTS to match the actual crystal (e.g. X2 on the
      Xiaomi CyberGear board is 16 MHz).

  fxosc-bypass:
    type: boolean
    description: |
      Enable FXOSC bypass mode for an externally driven clock input (no
      crystal resonator).  When set, fxosc-frequency must equal the
      external clock source frequency.

  fxosc-gain-selection:
    type: int
    required: false
    default: 6
    description: |
      FXOSC gain selection value passed to the vendor SCU configuration.

  pll-reference-clock:
    type: int
    required: false
    default: 0
    description: |
      PLL reference clock source, used only when system-clock-source is PLL.
      Use YTM32_PLL_REF_* values (scu_pll_ref_clk_t):
        0 = FXOSC  (requires fxosc-frequency; the usual crystal-accurate path)
        1 = FIRC
      The PLL input frequency finput = <reference-freq> / pll-reference-divider
      must stay within 8–40 MHz (RM §12.1; host tool clock.ts enforces 8–48 MHz).

  pll-feedback-divider:
    type: int
    required: false
    description: |
      PLL feedback divider (Ndiv / FBDIV), used only when system-clock-source
      is PLL.  Valid range 10–63 (host tool clock.ts).  The PLL output is:
        pll-out = (<reference-freq> / pll-reference-divider) * pll-feedback-divider / 2
      and must land in 100–200 MHz.  The driver enforces all of these with
      BUILD_ASSERT at compile time.

  pll-reference-divider:
    type: int
    required: false
    default: 1
    description: |
      PLL reference (pre-)divider (Npre / REFDIV), used only when
      system-clock-source is PLL.  Valid range 1 or 3–16 (value 2 is not
      supported by the hardware, per host tool clock.ts).

  core-clock:
    type: int
    required: true
    description: |
      Core (CPU / SysTick) clock frequency in Hz after all dividers.
      Derived value: core-clock = <source-freq> / core-divider, where
      <source-freq> is FIRC, FXOSC, or the PLL output depending on
      system-clock-source.
      A BUILD_ASSERT in the clock driver checks this identity at compile
      time to catch copy-paste errors.  CONFIG_SYS_CLOCK_HW_CYCLES_PER_SEC
      is auto-derived from this property via Kconfig dt_node_int_prop_int.

  core-divider:
    type: int
    required: true
    description: |
      Integer divider applied to the selected system clock source to produce
      the core clock.  Hardware-supported range: 1–16 (SCU FBDIVS register).

  fast-bus-divider:
    type: int
    required: false
    default: 1
    description: |
      Divider for the fast bus clock relative to the selected system clock.
      MVP-3 keeps the FIRC profile fixed and currently supports fast bus
      divider 1 only.

  slow-bus-divider:
    type: int
    required: false
    description: |
      Divider for the slow bus clock relative to the selected system clock.
      This is the preferred property for YTM32 SCU bus clock description.

  bus-divider:
    type: int
    required: false
    deprecated: true
    description: |
      Legacy alias for `slow-bus-divider`.
      Keep this only for transition from the early single-bus model.

clock-cells:
  - id
```

## dts/bindings/ytmicro,ytm32-dma.yaml
```yaml
description: YTMicro YTM32 DMA controller

compatible: "ytmicro,ytm32-dma"

include: [dma-controller.yaml]

properties:
  reg:
    required: true

  interrupts:
    required: true
    description: |
      Sixteen per-channel IRQs (DMA0..DMA15, indices 0-15) followed by
      one shared error IRQ (index 16). All 17 must be listed in order.

  clocks:
    type: phandle-array
    required: true
    description: DMA clock gate from the CGU.

  dma-channels:
    type: int
    required: true
    description: Total number of DMA virtual channels.

  "#dma-cells":
    const: 2

dma-cells:
  - channel   # Virtual channel number (0 to dma-channels - 1)
  - trigsrc   # DMAMUX request source (dma_request_source_t from YTM32B1MD1_features.h)
```

## dts/bindings/ytmicro,ytm32-etmr-pwm.yaml
```yaml
description: YTMicro YTM32 eTMR PWM controller

compatible: "ytmicro,ytm32-etmr-pwm"

include:
  - name: pwm-controller.yaml
  - name: pinctrl-device.yaml
  - name: base.yaml

properties:
  reg:
    required: true

  interrupts:
    required: true
    description: |
      Six interrupts in order: Ch0/Ch1, Ch2/Ch3, Ch4/Ch5, Ch6/Ch7, Fault, Overflow.

  interrupt-names:
    type: string-array
    required: true

  clocks:
    type: phandle-array
    required: true
    description: eTMR peripheral clock specifier from the CGU.

  ytmicro,instance:
    type: int
    required: true
    description: Hardware eTMR instance index (0-3).

  ytmicro,functional-clock-source:
    type: int
    required: true
    description: Functional clock source passed to the YTM32 clock controller (YTM32_CLOCK_SRC_*).

  ytmicro,functional-clock-divider:
    type: int
    required: false
    default: 1
    description: Functional clock divider passed to the YTM32 clock controller.

  ytmicro,prescaler:
    type: int
    required: false
    default: 0
    description: |
      eTMR internal clock prescaler. Counter clock = functional_clock >> prescaler.
      Valid range 0-7 (divide by 1, 2, 4, 8, 16, 32, 64, 128).

  ytmicro,phase-channels:
    type: array
    required: false
    description: |
      Even eTMR channel IDs for phase A, phase B, and phase C in the
      three-phase ISR fast path.  Each entry defines a complementary pair:
      the even channel and its following odd channel.  The driver derives
      the pair mask from this property, rejects odd, duplicate, or
      out-of-range entries, and keeps the outputs masked when the property is
      absent or invalid.

  ytmicro,deadtime-ns:
    type: int
    required: false
    default: 0
    description: |
      Dead-time insertion in nanoseconds, applied identically to all
      complementary pairs derived from ytmicro,phase-channels.

  ytmicro,pwm-frequency-hz:
    type: int
    required: false
    default: 20000
    description: |
      Initial PWM switching frequency in Hz used during driver init.
      The first pwm_set_cycles() call will override this.

  ytmicro,adc-sync-trigger:
    type: boolean
    description: |
      Emit a hardware INIT-match output trigger that drives the
      eTMR<n>_INIT_TRIG TMU source used to hardware-trigger the ADC
      (eTMR -> TMU -> ADC -> DMA chain) on MD1.  The trigger fires on the
      counter-bottom INIT match (OTRIG.INITTEN), the canonical instant to
      sample phase currents for center-aligned motor PWM.  The driver widens
      the pulse so it survives CIM resampling onto the ADC function clock.

  ytmicro,adc-trigger-width:
    type: int
    required: false
    default: 16
    description: |
      eTMR output trigger pulse width in counter clock cycles.
      Must be wide enough to be captured by CIM at the ADC functional clock.
      The minimum safe value depends on the ratio of eTMR clock to ADC
      functional clock. Default 16 cycles is empirically verified at 48 MHz
      eTMR / 4 MHz ADC (FXOSC ÷4).

  ytmicro,adc-mid-trigger:
    type: boolean
    description: |
      Emit a hardware MID-match output trigger via OTRIG.MIDTEN + the MID
      register (MID = MOD/2).  This fires eTMR<n>_EXT_TRIG (TMU slot 23)
      exactly once per PWM period at the carrier mid-point — the canonical
      instant for FOC phase-current sampling.  No channel is consumed; the
      driver updates MID automatically whenever the PWM period changes.
      Note: MIDTEN (an OTRIG register bit) maps to EXT_TRIG (slot 23), not
      INIT_TRIG (slot 22); only INITEN maps to INIT_TRIG.
      The ADC node must set ytmicro,hw-trigger-source to
      YTM32_TMU_SRC_ETMRn_EXT_TRIG accordingly.
      Mutually exclusive with ytmicro,adc-sync-trigger.

  ytmicro,fault-channels-mask:
    type: int
    required: false
    default: 0
    description: |
      Bitmask of eTMR fault inputs FLT0..FLT3 to configure.  A set bit
      configures the corresponding hardware fault input and its IRQ path.

  ytmicro,fault-active-low-mask:
    type: int
    required: false
    default: 0
    description: |
      Per-input polarity for configured fault inputs.  A set bit means a
      low input level is the active fault level; an unset bit means high.

  ytmicro,fault-filter-count:
    type: int
    required: false
    default: 0
    description: FAULT[FFCNT] filter sample counter value (0..15).

  ytmicro,fault-filter-period:
    type: int
    required: false
    default: 0
    description: FAULT[FFPER] filter sample period value (0..15).

  ytmicro,fault-input-stretch:
    type: boolean
    description: Enable FAULT[STRETCH] input pulse stretching.

  ytmicro,fault-combinational:
    type: boolean
    description: Enable the clockless FAULT[FCOMB] hardware shutdown path.

  ytmicro,fault-recovery:
    type: int
    required: false
    default: 0
    description: |
      Hardware recovery opportunity: 0 disabled, 1 MID, 2 MOD,
      3 immediate.  Motor-control boards must use 0.

  ytmicro,fault-auto-mode:
    type: int
    required: false
    default: 0
    description: |
      Fault automatic recovery mode.  0 requires manual flag clear before
      recovery; motor-control boards must use 0.

  ytmicro,autostart:
    type: boolean
    description: |
      Start the eTMR counter during driver initialisation.
      When absent (default), the counter is configured but not started;
      use this in applications that explicitly start PWM at boot.
      Motor applications and trigger-chain tests should set this property;
      non-motor users of the board should not.

  "#pwm-cells":
    const: 3

pwm-cells:
  - channel
  - period
  - flags
```

## dts/bindings/ytmicro,ytm32-flash-controller.yaml
```yaml
# Copyright (c) 2026 YI JIN <jinyi_2001@foxmail.com>
# SPDX-License-Identifier: Apache-2.0

description: |
  YTMicro YTM32 EFM (embedded flash module) controller.

  The controller node must contain a "soc-nv-flash" child describing the
  main array, with erase-block-size and write-block-size properties, e.g.:

      efm: flash-controller@40010000 {
          compatible = "ytmicro,ytm32-flash-controller";
          reg = <0x40010000 0x1000>;
          #address-cells = <1>;
          #size-cells = <1>;
          flash0: flash@0 {
              compatible = "soc-nv-flash";
              reg = <0x0 0x80000>;
              erase-block-size = <1024>;
              write-block-size = <8>;
          };
      };

compatible: "ytmicro,ytm32-flash-controller"

include: flash-controller.yaml
```

## dts/bindings/ytmicro,ytm32-flexcan.yaml
```yaml
description: YTMicro YTM32 FlexCAN controller

compatible: "ytmicro,ytm32-flexcan"

include: [can-controller.yaml, pinctrl-device.yaml]

properties:
  reg:
    required: true

  interrupts:
    required: true

  interrupt-names:
    type: string-array
    required: true

  clocks:
    type: phandle-array
    required: true
    description: FlexCAN peripheral clock specifier from the CGU.

  ytmicro,functional-clock-source:
    type: int
    required: true
    description: Functional clock source passed to the YTM32 clock controller.

  ytmicro,functional-clock-divider:
    type: int
    required: false
    default: 1
    description: Functional clock divider passed to the YTM32 clock controller.

  max-mb:
    type: int
    required: true
    description: Number of FlexCAN message buffers available on this instance.

  rx-mb-count:
    type: int
    required: false
    default: 8
    description: Number of message buffers reserved for Zephyr RX filters.

  tx-mb-count:
    type: int
    required: false
    default: 4
    description: Number of message buffers reserved for Zephyr TX operations.

  supports-fd:
    type: boolean
    description: This instance supports CAN FD.

  supports-enhanced-rx-fifo:
    type: boolean
    description: This instance supports the enhanced RX FIFO block.
```

## dts/bindings/ytmicro,ytm32-spi.yaml
```yaml
description: YTMicro YTM32 SPI controller

compatible: "ytmicro,ytm32-spi"

include: [spi-controller.yaml, pinctrl-device.yaml]

properties:
  reg:
    required: true

  interrupts:
    required: true

  clocks:
    type: phandle-array
    required: true
    description: SPI peripheral clock specifier from the CGU.

  ytmicro,functional-clock-source:
    type: int
    required: true
    description: Functional clock source passed to the YTM32 clock controller.

  ytmicro,functional-clock-divider:
    type: int
    required: false
    default: 1
    description: Functional clock divider passed to the YTM32 clock controller.

  pinctrl-0:
    type: phandles
    required: false

  pinctrl-names:
    type: string-array
    required: false

  dmas:
    type: phandle-array
    required: false
    description: |
      DMA channels for SPI TX and RX transfers. Each entry is a two-cell
      phandle-array: <&dma channel trigsrc>.
        channel : virtual DMA channel number (0-15 on YTM32B1MD1)
        trigsrc : DMAMUX request source (dma_request_source_t)
      Example (spi3, channels 6/7, SPI3_TX=61 / SPI3_RX=60):
        dmas = <&dma0 6 61>, <&dma0 7 60>;
        dma-names = "tx", "rx";
      Omit or keep dma0 disabled to fall back to interrupt-driven mode.

  dma-names:
    type: string-array
    required: false
    description: Must be "tx" and "rx" when 'dmas' is specified.
```
