## boards/ytmicro/ytm32b1md1_evb/board.yml
```yaml
# Copyright (c) 2026 YI JIN <jinyi_2001@foxmail.com>
# SPDX-License-Identifier: Apache-2.0

board:
  name: ytm32b1md1_evb
  full_name: YTM32B1MD1-EVB-Q100
  vendor: ytmicro
  socs:
    - name: ytm32b1md1
```

## boards/ytmicro/ytm32b1md1_evb/ytm32b1md1_evb_defconfig
```kconfig
# Copyright (c) 2026 YI JIN <jinyi_2001@foxmail.com>
# SPDX-License-Identifier: Apache-2.0

CONFIG_SOC_YTM32B1MD1=y
CONFIG_CLOCK_CONTROL=y
```

## drivers/Kconfig
```kconfig
rsource "adc/Kconfig"
rsource "pwm/Kconfig"
rsource "interrupt_controller/Kconfig"
rsource "serial/Kconfig"
rsource "clock_control/Kconfig"
rsource "counter/Kconfig"
rsource "pinctrl/Kconfig"
rsource "gpio/Kconfig"
rsource "spi/Kconfig"
rsource "can/Kconfig"
rsource "watchdog/Kconfig"
rsource "dma/Kconfig"
rsource "sensor/Kconfig"
```

## drivers/adc/Kconfig
```kconfig
config ADC_YTM32
	bool "YTM32 ADC driver"
	default y
	depends on DT_HAS_YTMICRO_YTM32_ADC_ENABLED
	select ADC
	help
	  Enable the YTMicro YTM32 ADC driver.
	  Supports interrupt-driven, software-triggered conversions with
	  up to 8 channels per sequence and 6/8/10/12-bit resolution.
```

## drivers/can/Kconfig
```kconfig
config CAN_YTM32
	bool "YTM32 FlexCAN driver"
	default y
	depends on DT_HAS_YTMICRO_YTM32_FLEXCAN_ENABLED
	select CAN
	help
	  Enable the YTMicro YTM32 FlexCAN controller driver.

config CAN_MAX_FILTER
	int "Maximum number of concurrent CAN RX filters"
	default 8
	depends on CAN_YTM32
	help
	  Maximum number of simultaneously active CAN RX filters per device.
	  Must not exceed the rx-mb-count property of the FlexCAN node.

config CAN_YTM32_TX_TIMEOUT_MS
	int "YTM32 CAN TX timeout in milliseconds"
	default 1000
	depends on CAN_YTM32
	help
	  Timeout used for blocking CAN transmissions.
```

## drivers/dma/Kconfig
```kconfig
config DMA_YTM32
	bool "YTM32 DMA controller driver"
	default y
	depends on DT_HAS_YTMICRO_YTM32_DMA_ENABLED
	select DMA
	help
	  Enable DMA driver for YTM32 series. Provides the Zephyr DMA API
	  and connects all per-channel IRQ handlers required by peripherals
	  (SPI, UART, I2C) that use DMA mode through the vendor HAL.

config DMA_YTM32_CH8_ZERO_LATENCY
	bool "Connect DMA channel 8 as a zero-latency direct IRQ"
	depends on DMA_YTM32 && ZERO_LATENCY_IRQS
	help
	  Connect DMA8_IRQn with IRQ_DIRECT_CONNECT and IRQ_ZERO_LATENCY for the
	  ADC DMA motor-control path. Other DMA channels remain normal Zephyr IRQs.

config DMA_YTM32_CH8_ZLI_TIMING
	bool "Instrument DMA channel 8 zero-latency interrupt timing"
	depends on DMA_YTM32_CH8_ZERO_LATENCY
	help
	  Use DWT->CYCCNT to timestamp the ADC DMA channel 8 zero-latency
	  interrupt path. Intended for trigger_chain timing validation only.
	  Requires CMSIS DWT/CoreDebug headers (provided by the vendor HAL).
```

## drivers/flash/Kconfig
```kconfig
# Copyright (c) 2026 YI JIN <jinyi_2001@foxmail.com>
# SPDX-License-Identifier: Apache-2.0

config FLASH_YTM32
	bool "YTMicro YTM32 EFM flash driver"
	default y
	depends on FLASH
	depends on HAS_YTMICRO_HAL
	depends on DT_HAS_YTMICRO_YTM32_FLASH_CONTROLLER_ENABLED
	select FLASH_HAS_PAGE_LAYOUT
	select FLASH_HAS_DRIVER_ENABLED
	help
	  Enable the flash driver for YTMicro YTM32 SoCs. It wraps the vendor
	  EFM FLASH_DRV_* API (synchronous mode). Program/erase transiently
	  disable the Cortex-M MPU inside an IRQ-masked window in the vendor
	  code, so do not call them from real-time control paths.
```

## drivers/pwm/Kconfig
```kconfig
config PWM_YTM32_ETMR
	bool "YTMicro YTM32 eTMR PWM driver"
	default y
	depends on DT_HAS_YTMICRO_YTM32_ETMR_PWM_ENABLED
	select PINCTRL
	help
	  Enable PWM driver for the YTM32 eTMR peripheral.
	  Supports independent and complementary output modes with
	  dead-time insertion, suitable for motor control (FOC) applications.
```

## drivers/sensor/ams/ams_as5047p/Kconfig
```kconfig
# AS5047P Angular position sensor configuration option

# Copyright (c) 2026 YI JIN <jinyi_2001@foxmail.com>
# SPDX-License-Identifier: Apache-2.0

config AMS_AS5047P
	bool "AMS AS5047P magnetic angle sensor"
	default y
	depends on DT_HAS_AMS_AS5047P_ENABLED
	select SPI
	help
	  Enable driver for the AMS AS5047P magnetic rotary encoder. The driver
	  supports reading the absolute angle via the SPI interface.
```

## drivers/spi/Kconfig
```kconfig
config SPI_YTM32
	bool "YTM32 SPI driver"
	default y
	depends on DT_HAS_YTMICRO_YTM32_SPI_ENABLED
	select SPI
	help
	  Enable YTM32 SPI controller driver.

config SPI_YTM32_TRANSFER_TIMEOUT_MS
	int "YTM32 SPI transfer timeout in milliseconds"
	default 1000
	depends on SPI_YTM32
	help
	  Timeout used while waiting for a SPI transfer to complete (both
	  interrupt-driven and DMA modes).

config SPI_YTM32_TRANSACTION_TIMEOUT_MS
	int "YTM32 SPI transaction gate timeout in milliseconds"
	default 1000
	depends on SPI_YTM32
	help
	  Maximum time a blocking SPI transaction waits for an in-flight async
	  transfer or another blocking transaction to release the hardware gate.
	  A timeout must leave the gate and spi_context usable for the next request.

config SPI_YTM32_DMA
	bool "YTM32 SPI DMA support"
	default y
	depends on SPI_YTM32 && DMA_YTM32
	help
	  When enabled and the SPI device tree node carries a valid 'dmas'
	  property, the driver initialises the SPI controller in DMA mode.
	  Each transfer segment is handed off to the vendor SPI HAL, which
	  uses the designated DMA channels internally.  Falls back to
	  interrupt-driven mode if the property is absent.
```

## drivers/tmu/Kconfig
```kconfig
# Copyright (c) 2026 YI JIN <jinyi_2001@foxmail.com>
# SPDX-License-Identifier: Apache-2.0

config YTM32_TMU
	bool "YTM32 TMU (Trigger MUX Unit) driver"
	default y
	depends on DT_HAS_YTMICRO_YTM32_TMU_ENABLED
	help
	  Enable the YTM32 TMU driver.  It owns the TMU peripheral clock,
	  applies the static trigger routes described in devicetree, and
	  exposes ytm32_tmu_route() for runtime routing (used e.g. by the ADC
	  driver to wire an eTMR trigger to the ADC external-trigger input).

if YTM32_TMU

config YTM32_TMU_INIT_PRIORITY
	int "YTM32 TMU init priority"
	default 45
	help
	  Device initialization priority for the TMU driver.  Must run after
	  the clock-control driver so the TMU clock gate can be enabled.

module = YTM32_TMU
module-str = YTM32 TMU
source "subsys/logging/Kconfig.template.log_config"

endif # YTM32_TMU
```

## dts/bindings/infineon,6edl7141.yaml
```yaml
description: Infineon MOTIX 6EDL7141 gate driver

compatible: "infineon,6edl7141"

include: spi-device.yaml

properties:
  en-gpios:
    type: phandle-array
    description: EN_DRV control GPIO.

  fault-gpios:
    type: phandle-array
    description: nFAULT status GPIO.
```

## dts/bindings/sensor/ams,as5047p.yaml
```yaml
# SPDX-License-Identifier: Apache-2.0

description: |
  AMS AS5047P magnetic rotary sensor

compatible: "ams,as5047p"

include: [sensor-device.yaml, spi-device.yaml]

properties:
  reg:
    required: true

  spi-max-frequency:
    required: true
```

## dts/bindings/ytmicro,ytm32-adc.yaml
```yaml
description: YTMicro YTM32 ADC controller

compatible: "ytmicro,ytm32-adc"

include: [adc-controller.yaml, pinctrl-device.yaml]

properties:
  reg:
    required: true

  interrupts:
    required: true

  clocks:
    type: phandle-array
    required: true
    description: ADC peripheral clock specifier from the CGU.

  ytmicro,functional-clock-source:
    type: int
    required: true
    description: Functional clock source passed to the YTM32 clock controller.

  ytmicro,functional-clock-divider:
    type: int
    required: false
    default: 1
    description: |
      IPC peripheral clock divider for the ADC bus clock.
      Passed to the YTM32 clock controller; the hardware divides the selected
      source by this value.  Default 1 = no division (source clock direct).
      This is separate from the ADC module's internal clock divider
      (ytmicro,adc-clock-divider), which further divides the IPC clock.


  ytmicro,adc-start-time:
    type: int
    required: false
    default: 32
    description: |
      ADC startup time register field (CFG1.STCNT), in ADC clock ticks.
      The vendor HAL writes this value directly via ADC_SetStartTime(); actual
      startup delay is (adc-start-time + 1) / FADC.

      Keep this consistent with FADC when changing ytmicro,adc-clock-divider:
        FADC=16 MHz  -> default 32 gives 33/16MHz = 2.06 us
        FADC=32 MHz  -> use at least 63 for 64/32MHz = 2.00 us

  ytmicro,adc-clock-divider:
    type: int
    required: false
    default: 2
    description: |
      ADC module internal clock divider (CFG1.PRS register field).

      IMPORTANT: the driver uses (n + 1) semantics, NOT 2^n:

        FADC = func_clk / (adc-clock-divider + 1)

      This matches the vendor HAL (adc_driver.c:105):
        adc_freq = func_clk / (1UL + clockDivider)
      and the factory frontend (App.vue:508):
        Func_clk_div = Func_clk / (clockDivider + 1)

      Encoding:
        0 = divide by 1  (ADC_CLK_DIVIDE_1)
        1 = divide by 2  (ADC_CLK_DIVIDE_2)
        2 = divide by 3  (SDK default ADC_DEFAULT_CLOCK_DIVIDER)
        3 = divide by 4
        ...
        7 = divide by 8
      Valid range: 0–15 (4-bit field, CFG1.PRS mask 0xF00).

      The driver validates FADC = func_clk / (divider + 1) against the
      YTM32B1MD1 DS v1.9 range [4, 32] MHz before enabling conversions.

      Datasheet DS v1.9 §6.4.5 specifies FADC 4--32 MHz and TSAMPLE
      100--1000 ns. The driver also validates the selected sample time and
      requires ADC startup time >= 2 us.

  ytmicro,sequence-order:
    type: array
    required: false
    description: |
      Optional explicit ADC sequence order. Each entry is a Zephyr ADC
      channel number. When present, it must contain every bit selected by the
      adc_sequence.channels mask at least once. A selected channel may be
      repeated to provide a sacrificial conversion for ADC E600001; an
      unselected channel or a partial mask is an error. When absent, selected
      channels are emitted in ascending channel order without duplicates.

  dmas:
    type: phandle-array
    required: false
    description: |
      DMA channel for draining the ADC FIFO in hardware-triggered mode.
      Provide one entry: <&dma0 channel slot>.

  dma-names:
    type: string-array
    required: false
    description: Must be "rx" when dmas is present.

  ytmicro,hw-trigger-source:
    type: int
    required: false
    description: |
      TMU trigger source index routed to ADC0_EXT_TRIG.
      Example: YTM32_TMU_SRC_ETMR0_INIT_TRIG (22).
      When absent, only software-triggered mode is available.

  ytmicro,tmu:
    type: phandle
    required: false
    description: |
      TMU device used to route ytmicro,hw-trigger-source to the ADC external
      trigger input when hardware-triggered DMA sampling is started.
      Required together with ytmicro,hw-trigger-source for Phase 2 DMA mode.

  ytmicro,cim-trigger-select:
    type: int
    required: false
    default: 2
    description: |
      CIM ADC0_TRIG_SEL field value selecting the hardware trigger source.
      Values (YTM32B1MD1 SVD, CIM_CTRL register):
        0 = PTU output
        1 = TMU output synchronised by bus clock
        2 = TMU output synchronised by ADC functional clock (recommended, default)
      Bus-clock sync (1) can drop the trigger edge on MD1 when the ADC
      functional clock is slow relative to the bus clock.

  "#io-channel-cells":
    const: 1

io-channel-cells:
  - input
```
