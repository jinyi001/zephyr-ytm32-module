## dts/bindings/ytmicro,ytm32-tmu.yaml
```yaml
# Copyright (c) 2026 YI JIN <jinyi_2001@foxmail.com>
# SPDX-License-Identifier: Apache-2.0

description: |
  YTMicro YTM32 TMU (Trigger MUX Unit).

  The TMU routes peripheral trigger sources to target modules (e.g. an eTMR
  counter-bottom pulse to the ADC external-trigger input).  Each target module
  selects exactly one source.

  Static routes may be described as child nodes; they are applied at driver
  init.  Routes can also be set at runtime with ytm32_tmu_route().

  Example:

    #include <zephyr/dt-bindings/tmu/ytm32b1md1-tmu.h>

    &tmu0 {
        status = "okay";
        route-etmr0-adc0 {
            source = <YTM32_TMU_SRC_ETMR0_INIT_TRIG>;
            target = <YTM32_TMU_TARGET_ADC0_EXT_TRIG>;
        };
    };

compatible: "ytmicro,ytm32-tmu"

include: base.yaml

properties:
  reg:
    required: true

  clocks:
    required: true

child-binding:
  description: |
    A single TMU route: connect one trigger source to one target module.
  properties:
    source:
      type: int
      required: true
      description: Trigger source id (YTM32_TMU_SRC_* from the SoC dt-bindings).
    target:
      type: int
      required: true
      description: Target module id (YTM32_TMU_TARGET_* from the SoC dt-bindings).
```

## soc/ytmicro/ytm32/ytm32b1m/Kconfig.soc
```kconfig
# Copyright (c) 2026 YI JIN <jinyi_2001@foxmail.com>
# SPDX-License-Identifier: Apache-2.0

config SOC_SERIES_YTM32B1M
	bool
	select SOC_FAMILY_YTMICRO_YTM32
	select ARM
	select CPU_CORTEX_M
	select CPU_CORTEX_M33
	select CPU_HAS_ARM_MPU
	select INIT_ARCH_HW_AT_BOOT
	select HAS_SEGGER_RTT if ZEPHYR_SEGGER_MODULE

config SOC_SERIES
	default "ytm32b1m" if SOC_SERIES_YTM32B1M

config SOC_YTM32B1MC0
	bool "YTM32B1MC0 MCU"
	select SOC_SERIES_YTM32B1M
	select SOC_PART_NUMBER_YTM32B1MC03H0MLHT

config SOC_YTM32B1MD1
	bool "YTM32B1MD1 MCU"
	select SOC_SERIES_YTM32B1M
	select SOC_PART_NUMBER_YTM32B1MD1
	select CPU_HAS_FPU
	select ARMV8_M_DSP

config SOC
	default "ytm32b1mc0" if SOC_YTM32B1MC0
	default "ytm32b1md1" if SOC_YTM32B1MD1

config SOC_PART_NUMBER_YTM32B1MC03H0MLHT
	bool

config SOC_PART_NUMBER_YTM32B1MD1
	bool

config SOC_PART_NUMBER
	default "YTM32B1MC03H0MLHT" if SOC_PART_NUMBER_YTM32B1MC03H0MLHT
	default "YTM32B1MD1" if SOC_PART_NUMBER_YTM32B1MD1
```
