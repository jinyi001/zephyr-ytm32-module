## boards/ytmicro/ytm32b1mc0_evb/Kconfig.ytm32b1mc0_evb
```kconfig
# Copyright (c) 2026 YI JIN <jinyi_2001@foxmail.com>
# SPDX-License-Identifier: Apache-2.0

config BOARD_YTM32B1MC0_EVB
	select SOC_YTM32B1MC0
```

## boards/ytmicro/ytm32b1mc0_evb/board.yml
```yaml
# Copyright (c) 2026 YI JIN <jinyi_2001@foxmail.com>
# SPDX-License-Identifier: Apache-2.0

board:
  name: ytm32b1mc0_evb
  full_name: YTM32B1MC0-EVB-Q64 Rev.A
  vendor: ytmicro
  socs:
    - name: ytm32b1mc0
```

## boards/ytmicro/ytm32b1mc0_evb/ytm32b1mc0_evb_defconfig
```kconfig
# Copyright (c) 2026 YI JIN <jinyi_2001@foxmail.com>
# SPDX-License-Identifier: Apache-2.0

CONFIG_SOC_YTM32B1MC0=y
CONFIG_PINCTRL=y

# Console
CONFIG_SERIAL=y
CONFIG_UART_CONSOLE=y

CONFIG_CLOCK_CONTROL=y

# GPIO
CONFIG_GPIO=y
```

## build-board-uart-poll/Kconfig/Kconfig.shield.defconfig
```kconfig
osource "C:/Users/JinYi/zephyrproject/zephyr-ytm32-module/boards/shields/*/Kconfig.defconfig"
```

## build-board-uart-poll/Kconfig/boards/Kconfig.defconfig.tmp
```kconfig
# Load Zephyr board defconfig descriptions.
osource "C:/Users/JinYi/zephyrproject/zephyr-ytm32-module/boards/ytmicro/ytm32b1mc0_evb/Kconfig.defconfig"
```

## drivers/clock_control/Kconfig
```kconfig
# Copyright (c) 2026 YI JIN <jinyi_2001@foxmail.com>
# SPDX-License-Identifier: Apache-2.0

config CLOCK_CONTROL_YTM32
	bool "YTMICRO YTM32 Clock Control driver"
	default y
	depends on HAS_YTMICRO_HAL
	depends on DT_HAS_YTMICRO_YTM32_CGU_ENABLED
	help
	  Enable support for YTM32 Clock Controller (CGU).

config CLOCK_CONTROL_YTM32_CMU
	bool "Enable YTM32 CMU monitoring"
	default y
	depends on CLOCK_CONTROL_YTM32
	help
	  Keep the SCU clock monitor enabled for the fixed FIRC/FXOSC MVP clock
	  profile. Disable this only on boards that intentionally do not use CMU.

config CLOCK_CONTROL_YTM32_CMU_RESET
	bool "Reset on YTM32 CMU fault"
	default y
	depends on CLOCK_CONTROL_YTM32_CMU
	help
	  Reset the SoC when CMU detects FIRC or FXOSC failure. Disable this if the
	  board wants interrupt-only handling later.

config CLOCK_CONTROL_YTM32_KEEP_SIRC_IN_DEEPSLEEP
	bool "Keep SIRC enabled in deepsleep"
	default y
	depends on CLOCK_CONTROL_YTM32
	help
	  Keep SIRC available while entering deepsleep. This matches the current EVB
	  baseline and keeps room for low-power wakeup and CMU reference usage.

config CLOCK_CONTROL_YTM32_KEEP_SIRC_IN_STANDBY
	bool "Keep SIRC enabled in standby"
	default y
	depends on CLOCK_CONTROL_YTM32
	help
	  Keep SIRC available while entering standby. Disable only after validating
	  board-specific low-power behavior.
```

## drivers/counter/Kconfig
```kconfig
# Copyright (c) 2026 YI JIN <jinyi_2001@foxmail.com>
# SPDX-License-Identifier: Apache-2.0

config COUNTER_YTM32_LPTMR
	bool "YTMicro YTM32 LPTMR counter driver"
	default y
	depends on COUNTER
	depends on HAS_YTMICRO_HAL
	depends on DT_HAS_YTMICRO_YTM32_LPTMR_ENABLED
	help
	  Enable the MVP counter driver for YTMicro YTM32 LPTMR0.
```

## drivers/gpio/Kconfig
```kconfig
# Copyright (c) 2026 YI JIN <jinyi_2001@foxmail.com>
# SPDX-License-Identifier: Apache-2.0

config GPIO_YTM32
	bool "YTMicro YTM32 GPIO driver"
	default y
	depends on GPIO
	depends on HAS_YTMICRO_HAL
	depends on DT_HAS_YTMICRO_YTM32_GPIO_ENABLED
	help
	  Enable GPIO driver for YTMicro YTM32 series MCUs.
```

## drivers/interrupt_controller/Kconfig
```kconfig
config INTC_YTM32
	bool "YTMicro YTM32 interrupt controller support"
	default y
	depends on SOC_FAMILY_YTMICRO_YTM32
	help
	  Enable the YTM32 interrupt controller glue driver.
```

## drivers/pinctrl/Kconfig
```kconfig
# Copyright (c) 2026 YI JIN <jinyi_2001@foxmail.com>
# SPDX-License-Identifier: Apache-2.0

config PINCTRL_YTM32
	bool "YTM32 pin controller driver"
	default y
	depends on DT_HAS_YTMICRO_YTM32_PINCTRL_ENABLED
	help
	  Enable the YTM32 pin controller driver.
```

## drivers/serial/Kconfig
```kconfig
config UART_YTM32
	bool "YTMicro YTM32 UART driver"
	default y
	depends on SERIAL
	depends on HAS_YTMICRO_HAL
	depends on DT_HAS_YTMICRO_YTM32_UART_ENABLED
	select SERIAL_HAS_DRIVER
	# NOTE: polling-only for now; do NOT select SERIAL_SUPPORT_INTERRUPT
	# until irq_tx_enable / irq_rx_enable / irq_callback_set are implemented.
```

## drivers/watchdog/Kconfig
```kconfig
# Copyright (c) 2026 YI JIN <jinyi_2001@foxmail.com>
# SPDX-License-Identifier: Apache-2.0

config WDT_YTM32
	bool "YTMicro YTM32 watchdog driver"
	default y
	depends on WATCHDOG
	depends on HAS_YTMICRO_HAL
	depends on DT_HAS_YTMICRO_YTM32_WDG_ENABLED
	select HAS_WDT_NO_CALLBACKS
	help
	  Enable the MVP watchdog driver for YTMicro YTM32 SoCs.
```

## dts/bindings/pinctrl/ytmicro,ytm32-pinctrl.yaml
```yaml
# Copyright (c) 2026 YTMicro
# SPDX-License-Identifier: Apache-2.0

description: YTM32 Pin Controller

compatible: "ytmicro,ytm32-pinctrl"

include:
  - name: base.yaml
  - name: pincfg-node.yaml

child-binding:
  description: |
    YTM32 pin controller pin configuration state nodes.

  child-binding:
    description: |
      YTM32 pin controller pin configuration group nodes.

    properties:
      pinmux:
        required: true
        type: array
        description: |
          An array of pin configurations.
          Each configuration is a 32-bit integer combining port, pin, and mux function.
          Use the YTM32_PINMUX macro to construct these values.

      drive-strength:
        type: string
        enum:
          - "low"
          - "high"
        description: |
          Drive strength of the pin.
```

## dts/bindings/ytmicro,ytm32-gpio.yaml
```yaml
# Copyright (c) 2026 YI JIN <jinyi_2001@foxmail.com>
# SPDX-License-Identifier: Apache-2.0

description: |
  YTMicro YTM32 GPIO controller.

  The YTM32 has separate GPIO (data/direction/interrupt) and PCTRL (pin mux)
  peripherals. The reg property should contain two entries:
    - First: GPIO register block (e.g., GPIOA at 0x40011000)
    - Second: PCTRL register block (e.g., PCTRLA at 0x40012000)

compatible: "ytmicro,ytm32-gpio"

include: [gpio-controller.yaml, base.yaml]

properties:
  reg:
    required: true

  interrupts:
    required: true

  clocks:
    required: true

  "#gpio-cells":
    const: 2

  ngpios:
    default: 32

gpio-cells:
  - pin
  - flags
```

## dts/bindings/ytmicro,ytm32-lptmr.yaml
```yaml
description: YTMicro YTM32 low-power timer counter

compatible: "ytmicro,ytm32-lptmr"

include: base.yaml

properties:
  reg:
    required: true

  interrupts:
    required: true

  clocks:
    type: phandle-array
    required: true
    description: LPTMR peripheral clock specifier from the CGU.

  ytmicro,functional-clock-source:
    type: int
    required: true
    description: |
      Functional clock source selection for this LPTMR.
      Use `YTM32_CLOCK_SRC_*` values from
      `zephyr/dt-bindings/clock/ytmicro,ytm32-clock.h`.

  ytmicro,prescaler:
    type: int
    required: false
    default: 1
    description: |
      Prescaler for LPTMR. Valid values are 1 (bypass), 2, 4, 8, 16, 32, 64, 128, 256, 512, 1024, 2048, 4096, 8192, 16384, 32768, 65536.
```

## dts/bindings/ytmicro,ytm32-pinctrl.yaml
```yaml
# Copyright (c) 2026 YTMicro
# SPDX-License-Identifier: Apache-2.0

description: YTM32 Pin Controller

compatible: "ytmicro,ytm32-pinctrl"

include:
  - name: base.yaml
  - name: pincfg-node.yaml

properties:
  clocks:
    type: phandle-array
    required: true
    description: |
      Clocks required by the pin controller (e.g. GPIO, PCTRL clocks).

child-binding:
  description: |
    YTM32 pin controller pin configuration state nodes.

  child-binding:
    description: |
      YTM32 pin controller pin configuration group nodes.

    properties:
      pinmux:
        required: true
        type: array
        description: |
          An array of pin configurations.
          Each configuration is a 32-bit integer combining port, pin, and mux function.
          Use the YTM32_PINMUX macro to construct these values.

      drive-strength:
        type: string
        enum:
          - "low"
          - "high"
        description: Drive strength of the pin.
      bias-pull-up:
        type: boolean
        description: Enable pull-up resistor.
      bias-pull-down:
        type: boolean
        description: Enable pull-down resistor.
      bias-disable:
        type: boolean
        description: Disable pull-up/down resistors.
      drive-open-drain:
        type: boolean
        description: Enable open-drain output.
      drive-push-pull:
        type: boolean
        description: Enable push-pull output.
      slew-rate:
        type: string
        enum:
          - "slow"
          - "fast"
        description: Slew rate of the pin.
      ytmicro,passive-filter:
        type: boolean
        description: Enable passive filter for the pin (YTMicro specific).
```

## dts/bindings/ytmicro,ytm32-uart.yaml
```yaml
description: YTMicro YTM32 UART
compatible: "ytmicro,ytm32-uart"
include: [uart-controller.yaml, pinctrl-device.yaml]

properties:
  reg:
    required: true
  interrupts:
    required: true
  clocks:
    type: phandle-array
    required: true
    description: UART peripheral clock specifier from the CGU.
  ytmicro,functional-clock-source:
    type: int
    required: true
    description: |
      IPC functional clock source selection for this UART.
      Use `YTM32_CLOCK_SRC_*` values from
      `zephyr/dt-bindings/clock/ytmicro,ytm32-clock.h`.
  ytmicro,functional-clock-divider:
    type: int
    required: false
    default: 1
    description: |
      UART IPC functional clock divider expressed as the hardware divide value.
      Valid range is 1 to 16.
  pinctrl-0:
    type: phandles
    required: false
  pinctrl-names:
    type: string-array
    required: false
  current-speed:
    type: int
    description: Initial baud rate setting for UART
```

## dts/bindings/ytmicro,ytm32-wdg.yaml
```yaml
description: YTMicro YTM32 watchdog
compatible: "ytmicro,ytm32-wdg"
include: base.yaml

properties:
  reg:
    required: true
  interrupts:
    required: false
  clocks:
    type: phandle-array
    required: true
    description: Watchdog peripheral clock specifier from the CGU.
  ytmicro,timeout-clock-source:
    type: int
    required: false
    default: 0
    enum:
      - 0
      - 1
    description: |
      Watchdog counter clock source.
      0 selects the 32 kHz LPO and 1 selects the 2 MHz SIRC.
```

## samples/build/Kconfig/Kconfig.shield
```kconfig
osource "/root/zephyrproject/zephyr-ytm32-module/boards/shields/*/Kconfig.shield"
```

## samples/build/Kconfig/arch/Kconfig
```kconfig
# Load Zephyr Arch Kconfig descriptions.
osource "/root/zephyrproject/zephyr/arch/rx/Kconfig"
osource "/root/zephyrproject/zephyr/arch/x86/Kconfig"
osource "/root/zephyrproject/zephyr/arch/xtensa/Kconfig"
osource "/root/zephyrproject/zephyr/arch/sparc/Kconfig"
osource "/root/zephyrproject/zephyr/arch/riscv/Kconfig"
osource "/root/zephyrproject/zephyr/arch/posix/Kconfig"
osource "/root/zephyrproject/zephyr/arch/mips/Kconfig"
osource "/root/zephyrproject/zephyr/arch/arm64/Kconfig"
osource "/root/zephyrproject/zephyr/arch/arm/Kconfig"
osource "/root/zephyrproject/zephyr/arch/arc/Kconfig"
```

## samples/build/Kconfig/boards/Kconfig.defconfig.tmp
```kconfig
# Load Zephyr board defconfig descriptions.
osource "/root/zephyrproject/zephyr-ytm32-module/boards/ytmicro/ytm32b1mc0_evb/Kconfig.defconfig"
```

## samples/build/Kconfig/boards/Kconfig.ytm32b1mc0_evb.tmp
```kconfig
# Load board Kconfig descriptions.
osource "/root/zephyrproject/zephyr-ytm32-module/boards/ytmicro/ytm32b1mc0_evb/Kconfig.ytm32b1mc0_evb"
```
