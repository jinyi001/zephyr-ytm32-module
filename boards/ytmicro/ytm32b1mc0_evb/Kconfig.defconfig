## samples/build/Kconfig/soc/Kconfig
```kconfig
# Load Zephyr SoC Kconfig descriptions.
osource "/root/zephyrproject/zephyr/soc/xlnx/zynqmp/Kconfig"
osource "/root/zephyrproject/zephyr/soc/xlnx/zynq7000/Kconfig"
osource "/root/zephyrproject/zephyr/soc/xlnx/versalnet/Kconfig"
osource "/root/zephyrproject/zephyr/soc/xlnx/versal2/Kconfig"
osource "/root/zephyrproject/zephyr/soc/xlnx/versal/Kconfig"
osource "/root/zephyrproject/zephyr/soc/xen/Kconfig"
osource "/root/zephyrproject/zephyr/soc/wch/ch32v/Kconfig"
osource "/root/zephyrproject/zephyr/soc/ti/simplelink/Kconfig"
osource "/root/zephyrproject/zephyr/soc/ti/mspm0/Kconfig"
osource "/root/zephyrproject/zephyr/soc/ti/lm3s6965/Kconfig"
osource "/root/zephyrproject/zephyr/soc/ti/k3/Kconfig"
osource "/root/zephyrproject/zephyr/soc/telink/tlsr/Kconfig"
osource "/root/zephyrproject/zephyr/soc/starfive/jh71xx/Kconfig"
osource "/root/zephyrproject/zephyr/soc/st/stm32/Kconfig"
osource "/root/zephyrproject/zephyr/soc/snps/qemu_arc/Kconfig"
osource "/root/zephyrproject/zephyr/soc/snps/nsim/arc_v/Kconfig"
osource "/root/zephyrproject/zephyr/soc/snps/nsim/arc_classic/Kconfig"
osource "/root/zephyrproject/zephyr/soc/snps/hsdk4xd/Kconfig"
osource "/root/zephyrproject/zephyr/soc/snps/hsdk/Kconfig"
osource "/root/zephyrproject/zephyr/soc/snps/emsk/Kconfig"
osource "/root/zephyrproject/zephyr/soc/snps/emsdp/Kconfig"
osource "/root/zephyrproject/zephyr/soc/snps/arc_iot/Kconfig"
osource "/root/zephyrproject/zephyr/soc/silabs/Kconfig"
osource "/root/zephyrproject/zephyr/soc/sifli/sf32/Kconfig"
osource "/root/zephyrproject/zephyr/soc/sifive/sifive_freedom/Kconfig"
osource "/root/zephyrproject/zephyr/soc/sensry/Kconfig"
osource "/root/zephyrproject/zephyr/soc/rockchip/Kconfig"
osource "/root/zephyrproject/zephyr/soc/renode/riscv_virtual/Kconfig"
osource "/root/zephyrproject/zephyr/soc/renode/cortex_r8_virtual/Kconfig"
osource "/root/zephyrproject/zephyr/soc/renesas/smartbond/Kconfig"
osource "/root/zephyrproject/zephyr/soc/renesas/rz/Kconfig"
osource "/root/zephyrproject/zephyr/soc/renesas/rx/Kconfig"
osource "/root/zephyrproject/zephyr/soc/renesas/rcar/Kconfig"
osource "/root/zephyrproject/zephyr/soc/renesas/ra/Kconfig"
osource "/root/zephyrproject/zephyr/soc/realtek/fingerprint/Kconfig"
osource "/root/zephyrproject/zephyr/soc/realtek/ec/Kconfig"
osource "/root/zephyrproject/zephyr/soc/realtek/bee/Kconfig"
osource "/root/zephyrproject/zephyr/soc/realtek/ameba/Kconfig"
osource "/root/zephyrproject/zephyr/soc/raspberrypi/rpi_pico/Kconfig"
osource "/root/zephyrproject/zephyr/soc/quicklogic/eos_s3/Kconfig"
osource "/root/zephyrproject/zephyr/soc/qemu/virt_riscv/Kconfig"
osource "/root/zephyrproject/zephyr/soc/qemu/malta/Kconfig"
osource "/root/zephyrproject/zephyr/soc/openisa/rv32m1/Kconfig"
osource "/root/zephyrproject/zephyr/soc/openhwgroup/cva6/Kconfig"
osource "/root/zephyrproject/zephyr/soc/oct/osd32mp15x/Kconfig"
osource "/root/zephyrproject/zephyr/soc/nxp/s32/Kconfig"
osource "/root/zephyrproject/zephyr/soc/nxp/rw/Kconfig"
osource "/root/zephyrproject/zephyr/soc/nxp/mcx/Kconfig"
osource "/root/zephyrproject/zephyr/soc/nxp/lpc/Kconfig"
osource "/root/zephyrproject/zephyr/soc/nxp/layerscape/Kconfig"
osource "/root/zephyrproject/zephyr/soc/nxp/kinetis/Kconfig"
osource "/root/zephyrproject/zephyr/soc/nxp/imxrt/Kconfig"
osource "/root/zephyrproject/zephyr/soc/nxp/imx/Kconfig"
osource "/root/zephyrproject/zephyr/soc/nuvoton/numicro/Kconfig"
osource "/root/zephyrproject/zephyr/soc/nuvoton/numaker/Kconfig"
osource "/root/zephyrproject/zephyr/soc/nuvoton/npcx/Kconfig"
osource "/root/zephyrproject/zephyr/soc/nuvoton/npcm/Kconfig"
osource "/root/zephyrproject/zephyr/soc/nordic/Kconfig"
osource "/root/zephyrproject/zephyr/soc/neorv32/Kconfig"
osource "/root/zephyrproject/zephyr/soc/native/inf_clock/Kconfig"
osource "/root/zephyrproject/zephyr/soc/microchip/sam/sama7/Kconfig"
osource "/root/zephyrproject/zephyr/soc/microchip/sam/sam_d5x_e5x/Kconfig"
osource "/root/zephyrproject/zephyr/soc/microchip/pic64/Kconfig"
osource "/root/zephyrproject/zephyr/soc/microchip/pic32c/pic32cz_ca/Kconfig"
osource "/root/zephyrproject/zephyr/soc/microchip/pic32c/pic32cx_sg/Kconfig"
osource "/root/zephyrproject/zephyr/soc/microchip/pic32c/pic32cm_pl/Kconfig"
osource "/root/zephyrproject/zephyr/soc/microchip/pic32c/pic32cm_jh/Kconfig"
osource "/root/zephyrproject/zephyr/soc/microchip/miv/Kconfig"
osource "/root/zephyrproject/zephyr/soc/microchip/mec/Kconfig"
osource "/root/zephyrproject/zephyr/soc/mediatek/mt8xxx/Kconfig"
osource "/root/zephyrproject/zephyr/soc/lowrisc/opentitan/Kconfig"
osource "/root/zephyrproject/zephyr/soc/litex/litex_vexriscv/Kconfig"
osource "/root/zephyrproject/zephyr/soc/ite/ec/Kconfig"
osource "/root/zephyrproject/zephyr/soc/intel/wildcat_lake/Kconfig"
osource "/root/zephyrproject/zephyr/soc/intel/raptor_lake/Kconfig"
osource "/root/zephyrproject/zephyr/soc/intel/panther_lake/Kconfig"
osource "/root/zephyrproject/zephyr/soc/intel/lakemont/Kconfig"
osource "/root/zephyrproject/zephyr/soc/intel/intel_socfpga_std/Kconfig"
osource "/root/zephyrproject/zephyr/soc/intel/intel_socfpga/Kconfig"
osource "/root/zephyrproject/zephyr/soc/intel/intel_niosv/Kconfig"
osource "/root/zephyrproject/zephyr/soc/intel/intel_ish/Kconfig"
osource "/root/zephyrproject/zephyr/soc/intel/intel_adsp/Kconfig"
osource "/root/zephyrproject/zephyr/soc/intel/elkhart_lake/Kconfig"
osource "/root/zephyrproject/zephyr/soc/intel/atom/Kconfig"
osource "/root/zephyrproject/zephyr/soc/intel/apollo_lake/Kconfig"
osource "/root/zephyrproject/zephyr/soc/intel/alder_lake/Kconfig"
osource "/root/zephyrproject/zephyr/soc/infineon/psoc4/Kconfig"
osource "/root/zephyrproject/zephyr/soc/infineon/edge/Kconfig"
osource "/root/zephyrproject/zephyr/soc/infineon/cat3/Kconfig"
osource "/root/zephyrproject/zephyr/soc/infineon/cat1c/Kconfig"
osource "/root/zephyrproject/zephyr/soc/infineon/cat1b/Kconfig"
osource "/root/zephyrproject/zephyr/soc/infineon/cat1a/Kconfig"
osource "/root/zephyrproject/zephyr/soc/gd/gd32/Kconfig"
osource "/root/zephyrproject/zephyr/soc/gaisler/leon3/Kconfig"
osource "/root/zephyrproject/zephyr/soc/gaisler/gr716a/Kconfig"
osource "/root/zephyrproject/zephyr/soc/focaltech/Kconfig"
osource "/root/zephyrproject/zephyr/soc/espressif/Kconfig"
osource "/root/zephyrproject/zephyr/soc/ene/kb1200/Kconfig"
osource "/root/zephyrproject/zephyr/soc/ene/kb106x/Kconfig"
osource "/root/zephyrproject/zephyr/soc/elan/em32f967/Kconfig"
osource "/root/zephyrproject/zephyr/soc/egis/Kconfig"
osource "/root/zephyrproject/zephyr/soc/efinix/sapphire/Kconfig"
osource "/root/zephyrproject/zephyr/soc/cdns/xtensa_sample_controller/Kconfig"
osource "/root/zephyrproject/zephyr/soc/cdns/sample_controller32/Kconfig"
osource "/root/zephyrproject/zephyr/soc/cdns/dc233c/Kconfig"
osource "/root/zephyrproject/zephyr/soc/brcm/bcmvk/Kconfig"
osource "/root/zephyrproject/zephyr/soc/brcm/bcm2712/Kconfig"
osource "/root/zephyrproject/zephyr/soc/brcm/bcm2711/Kconfig"
osource "/root/zephyrproject/zephyr/soc/blackberry/qnxhv_vm/Kconfig"
osource "/root/zephyrproject/zephyr/soc/bflb/Kconfig"
osource "/root/zephyrproject/zephyr/soc/atmel/sam0/Kconfig"
osource "/root/zephyrproject/zephyr/soc/atmel/sam/Kconfig"
osource "/root/zephyrproject/zephyr/soc/aspeed/Kconfig"
osource "/root/zephyrproject/zephyr/soc/arm/Kconfig"
osource "/root/zephyrproject/zephyr/soc/arm/beetle/Kconfig"
osource "/root/zephyrproject/zephyr/soc/antmicro/myra/Kconfig"
osource "/root/zephyrproject/zephyr/soc/andestech/Kconfig"
osource "/root/zephyrproject/zephyr/soc/amd/acp_6_0/Kconfig"
osource "/root/zephyrproject/zephyr/soc/ambiq/Kconfig"
osource "/root/zephyrproject/zephyr/soc/allwinner/sun8i_h3/Kconfig"
osource "/root/zephyrproject/zephyr/soc/alif/ensemble/Kconfig"
osource "/root/zephyrproject/zephyr/soc/aesc/Kconfig"
osource "/root/zephyrproject/zephyr/soc/adi/max32/Kconfig"
osource "/root/zephyrproject/zephyr-ytm32-module/soc/ytmicro/ytm32/Kconfig"
```
