## tests/unit/adc_sequence/testcase.yaml
```yaml
tests:
  drivers.adc.ytm32.sequence:
    tags:
      - drivers
      - adc
      - ytm32
    harness: ztest
    platform_allow:
      - native_sim/native/64
```

## tests/unit/etmr_pwm_map/testcase.yaml
```yaml
tests:
  drivers.pwm.ytm32.etmr_map:
    tags:
      - drivers
      - pwm
      - ytm32
    harness: ztest
    platform_allow:
      - native_sim/native/64
```

## tests/unit/spi_transaction/testcase.yaml
```yaml
tests:
  drivers.spi.ytm32.transaction:
    tags:
      - drivers
      - spi
      - ytm32
    harness: ztest
    platform_allow:
      - native_sim/native/64
```
