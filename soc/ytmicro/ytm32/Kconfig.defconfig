## soc/ytmicro/ytm32/Kconfig.defconfig
```kconfig
# Copyright (c) 2026 YI JIN <jinyi_2001@foxmail.com>
# SPDX-License-Identifier: Apache-2.0

if SOC_FAMILY_YTMICRO_YTM32

rsource "*/Kconfig.defconfig"

endif # SOC_FAMILY_YTMICRO_YTM32
```

## soc/ytmicro/ytm32/Kconfig.soc
```kconfig
# Copyright (c) 2026 YI JIN <jinyi_2001@foxmail.com>
# SPDX-License-Identifier: Apache-2.0

config SOC_FAMILY_YTMICRO_YTM32
	bool

config SOC_FAMILY
	default "ytmicro_ytm32" if SOC_FAMILY_YTMICRO_YTM32

rsource "*/Kconfig.soc"
```

## zephyr/Kconfig
```kconfig
# Driver options are routed from the module Kconfig entry point.
# SoC and board Kconfig trees are registered separately through
# zephyr/module.yml via soc_root and board_root.
rsource "../drivers/Kconfig"
```
